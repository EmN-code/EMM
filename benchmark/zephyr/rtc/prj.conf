## CMakeLists.txt
```
# SPDX-License-Identifier: Apache-2.0
cmake_minimum_required(VERSION 3.20.0)
set(BOARD esp32_devkitc_wroom)

find_package(Zephyr REQUIRED HINTS $ENV{ZEPHYR_BASE})
project(RTC)


target_sources(app PRIVATE src/main.c)
```

## prj.conf
```kconfig
CONFIG_LOG=y
CONFIG_REQUIRES_FULL_LIBC=y
CONFIG_POSIX_API=y
CONFIG_POSIX_TIMERS=y
CONFIG_POSIX_CLOCK_SELECTION=y
```

## src/main.c
```c
#include <zephyr/logging/log.h>
LOG_MODULE_REGISTER(RTC_sample, LOG_LEVEL_DBG);

#include <zephyr/kernel.h>
#include <time.h>
#include <sys/time.h>


int main(void){

	time_t t;
	struct tm *gmt, *area;

	while(1){
		k_sleep(K_SECONDS(1));
		t = time(NULL);
		area = localtime(&t);
		printk("Local time is: %s", asctime(area));
		gmt = gmtime(&t);
		printk("GMT is: %s", asctime(gmt));
	}
	
	return 0;
}
```
